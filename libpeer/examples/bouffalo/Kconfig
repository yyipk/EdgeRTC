## libpeer/examples/bouffalo/Kconfig
```kconfig
mainmenu "SDK Configuration"

config PICOLIBC_TLS
    default y if CHIP = "bl618dg" && CPU_ID = "ap" && CPU_MODEL = "b0"

source "$BL_SDK_BASE/Kconfig"

config EDGERTC_PLATFORM_BOUFFALO
    bool "EdgeRTC Bouffalo platform"
    depends on MEDIA_GRAPH
    select LWIP
    select MBEDTLS
    select SRTP
    select MBEDTLS_TLS_VERSION_1_2 if !MBEDTLS_V2
    select MBEDTLS_DTLS if !MBEDTLS_V2
    select MBEDTLS_X509_CRT_WRITE_C if !MBEDTLS_V2

config LIBPEER_USE_EXTERNAL_TRANSPORT
    bool "Use application WebRTC transport tasks"
    depends on EDGERTC_PLATFORM_BOUFFALO
    select MQTT
    select HTTP
    select HTTP_CLIENT

config MBEDTLS_GCM_ALT
    bool "Use hardware accelerated GCM"

config AUDIO_CODEC_ES8388_ENABLE_ADC_ALC
    bool "Enable ES8388 ADC automatic level control"

config CODEC_USE_JY6316
    bool "Use the external JY6316 codec"
    depends on CODEC_USE_I2S && AUDIO_CODEC_JY6316_ENABLE

config WEBRTC_VIDEO_RX
    bool "Display browser JPEG video on the BL618DG LCD"
    depends on BSP_LCD && LVGL9 && MG_VIDEO && CHIP = "bl618dg"
    select MG_VIDEO_MJPEG_HW_DECODER
    select LVGL9_OSD_LAYER
```

## libpeer/examples/bouffalo/defconfig
```kconfig
# Core
CONFIG_BFLB_LOG =y
CONFIG_FREERTOS =y
CONFIG_POSIX =y
CONFIG_TLSF =y
CONFIG_SHELL =y
CONFIG_SHELL_CMD_SIZE=256
CONFIG_LWIP =y
CONFIG_FHOST =y
CONFIG_WIFI6 =y
CONFIG_RF =y
CONFIG_MBEDTLS =y
CONFIG_MBEDTLS_V2 =y
CONFIG_DHCPD =y
CONFIG_MQTT =y

CONFIG_VSNPRINTF_FLOAT =y
CONFIG_VSNPRINTF_FLOAT_EX =y
CONFIG_VSNPRINTF_LONG_LONG =y

# TLS acceleration
CONFIG_MBEDTLS_AES_USE_HW =y
CONFIG_MBEDTLS_GCM_ALT =y
CONFIG_MBEDTLS_BIGNUM_USE_HW =y
CONFIG_MBEDTLS_ECC_USE_HW =y
CONFIG_MBEDTLS_SHA1_USE_HW =n
CONFIG_MBEDTLS_SHA256_USE_HW =y
CONFIG_MBEDTLS_SHA512_USE_HW =y

CONFIG_PS_EXTEND =y
CONFIG_PSRAM=y
# Leave PSRAM available for media and graphics buffers.
CONFIG_PSRAM_COPY_CODE=y
CONFIG_DUALCORE_DISABLE=y

# DVP camera and hardware MJPEG encoder
CONFIG_BSP_IMAGE_SENSOR =y
CONFIG_MG_VIDEO =y
CONFIG_MG_VIDEO_MJPEG =y

# Microphone capture
CONFIG_MULTIMEDIA =y
CONFIG_MEDIA_GRAPH =y
CONFIG_DRV_SND_BL616 =y
CONFIG_MINIALSA =y
CONFIG_XCODEC =y
CONFIG_XPORT =y
CONFIG_XUTILS =y
CONFIG_XRECORD =y
CONFIG_XWEBSOCKET =y
CONFIG_AEC4=n
CONFIG_SPEEXDSP_ALG=y
CONFIG_MG_SPEEXDSP_AEC_PREPROCESS=y
CONFIG_RNNOISE_NS=n
CONFIG_ALIGENIE_NS=y
CONFIG_USERVICE =y
CONFIG_AV =y

CONFIG_ROMAPI=n

CONFIG_BSP_AUDIO_CODEC =y
CONFIG_CODEC_USE_I2S =y
ifeq ($(CHIP),bl618dg)
CONFIG_CODEC_USE_JY6316=y
CONFIG_AUDIO_CODEC_JY6316_ENABLE=y
endif
CONFIG_AUDIO_CODEC_ES8388_ENABLE_ADC_ALC=n
CONFIG_MSP_USE_CODEC_ONLY =n
CONFIG_MSP_USE_STATIC_RAM =n

# WebRTC
CONFIG_LIBPEER=n
CONFIG_EDGERTC_PLATFORM_BOUFFALO=y
CONFIG_LIBPEER_USE_EXTERNAL_TRANSPORT =y
CONFIG_SRTP =y
CONFIG_IPERF =y

# Persistent signaling configuration
CONFIG_BFLB_MTD =y
CONFIG_PARTITION =y
CONFIG_LITTLEFS =y

CONFIG_MACSW_SELECT =default
ifeq ($(CHIP),bl618dg)
# NP is disabled; use the full 16 MiB PSRAM for AP and the LCD buffers.
CONFIG_PSRAM_LENGTH=0x1000000
CONFIG_PSRAM_FOR_AP_SIZE=0x1000000
CONFIG_BSP_LCD=y
CONFIG_WEBRTC_VIDEO_RX=y
else
CONFIG_BSP_LCD=n
endif
CONFIG_LVGL9=$(CONFIG_BSP_LCD)
CONFIG_LVGL9_PORT_DISP=$(CONFIG_BSP_LCD)
CONFIG_LVGL9_PORT_INDEV=n
CONFIG_LVGL9_PORT_FS=n
```
